#include "honey.dtsi" // The shared dtsi file is included in the overlay

// Label of the kscan node in the dtsi
&default_kscan {
    col-gpios = <&pro_micro 5 GPIO_ACTIVE_HIGH>,
                <&pro_micro 4 GPIO_ACTIVE_HIGH>,
                <&pro_micro 3 GPIO_ACTIVE_HIGH>,
                <&pro_micro 2 GPIO_ACTIVE_HIGH>,
                <&pro_micro 0 GPIO_ACTIVE_HIGH>,
                <&pro_micro 1 GPIO_ACTIVE_HIGH>;
};

&default_transform { // Offset of 6 because the left side has 6 columns
    col-offset = <6>;
};