## config/boards/shields/honey/Kconfig.defconfig
```kconfig
if SHIELD_HONEY_LEFT

config ZMK_KEYBOARD_NAME
    default "Honey"

config ZMK_SPLIT_ROLE_CENTRAL
    default y

endif

if SHIELD_HONEY_LEFT || SHIELD_HONEY_RIGHT

config ZMK_SPLIT
    default y

endif
```

## config/boards/shields/honey/Kconfig.shield
```kconfig
config SHIELD_HONEY_LEFT
    def_bool $(shields_list_contains,honey_left)

config SHIELD_HONEY_RIGHT
    def_bool $(shields_list_contains,honey_right)
```
